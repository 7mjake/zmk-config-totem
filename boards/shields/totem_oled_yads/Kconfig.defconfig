## boards/shields/totem_oled_yads/Kconfig.defconfig
```kconfig
# Copyright (c) 2026
# SPDX-License-Identifier: MIT

if SHIELD_TOTEM_OLED_YADS

choice ZMK_DISPLAY_STATUS_SCREEN
    default ZMK_DISPLAY_STATUS_SCREEN_CUSTOM
endchoice

config ZMK_DISPLAY_STATUS_SCREEN_CUSTOM
    select LV_USE_LABEL
    select LV_USE_BAR
    select LV_FONT_UNSCII_8

choice ZMK_DISPLAY_WORK_QUEUE
    default ZMK_DISPLAY_WORK_QUEUE_DEDICATED
endchoice

config LV_Z_MEM_POOL_SIZE
    default 16384

config LV_Z_VDB_SIZE
    default 100

config LV_DPI_DEF
    default 148

config LV_Z_BITS_PER_PIXEL
    default 1

choice LV_COLOR_DEPTH
    default LV_COLOR_DEPTH_1
endchoice

endif
```

## boards/shields/totem_oled_yads/Kconfig.shield
```kconfig
# Copyright (c) 2026
# SPDX-License-Identifier: MIT

config SHIELD_TOTEM_OLED_YADS
    def_bool $(shields_list_contains,totem_oled_yads)
```

## config/boards/shields/totem/Kconfig.defconfig
```kconfig
# Copyright (c) 2022 The ZMK Contributors
# SPDX-License-Identifier: MIT

if SHIELD_TOTEM_DONGLE || SHIELD_TOTEM_DONGLE_OLED

config ZMK_KEYBOARD_NAME
    default "TOTEM"

config ZMK_SPLIT_ROLE_CENTRAL
    default y

config ZMK_SPLIT_BLE_CENTRAL_PERIPHERALS
    default 2

config BT_MAX_CONN
    default 7

config BT_MAX_PAIRED
    default 7

endif

if SHIELD_TOTEM_DONGLE_OLED

config I2C
    default y

config SSD1306
    default y

endif

if SHIELD_TOTEM_LEFT || SHIELD_TOTEM_RIGHT || SHIELD_TOTEM_DONGLE || SHIELD_TOTEM_DONGLE_OLED

config ZMK_SPLIT
    default y

endif
```
